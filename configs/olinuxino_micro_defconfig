## configs/olinuxino_micro_defconfig
```kconfig
BR2_arm=y
BR2_arm926t=y
BR2_TOOLCHAIN_EXTERNAL=y
BR2_ROOTFS_DEVICE_CREATION_DYNAMIC_DEVTMPFS=y
BR2_TARGET_GENERIC_GETTY_PORT="ttyAMA0"
BR2_TARGET_ROOTFS_EXT2=y
# BR2_TARGET_ROOTFS_TAR is not set
BR2_TARGET_MXS_BOOTLETS=y
BR2_TARGET_MXS_BOOTLETS_CUSTOM_TARBALL=y
BR2_TARGET_MXS_BOOTLETS_CUSTOM_TARBALL_URL="http://github.com/fhunleth/imx-bootlets-imx23_olinuxino_dev/tarball/3f8b3b9/fhunleth-imx-bootlets-imx23_olinuxino_dev-3f8b3b9.tar.gz"
BR2_TARGET_MXS_BOOTLETS_CUSTOM_BOARD=y
BR2_TARGET_MXS_BOOTLETS_CUSTOM_BOARD_NAME="imx23_olinuxino_dev"
BR2_LINUX_KERNEL=y
BR2_LINUX_KERNEL_USE_CUSTOM_CONFIG=y
BR2_LINUX_KERNEL_CUSTOM_CONFIG_FILE="board/olimex/olinuxino/linux-3.7.config"
BR2_LINUX_KERNEL_APPENDED_ZIMAGE=y
BR2_LINUX_KERNEL_INTREE_DTS_NAME="imx23-olinuxino"
```
